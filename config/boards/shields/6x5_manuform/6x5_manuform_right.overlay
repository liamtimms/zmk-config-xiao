// 6x5_manuform_right.overlay

#include "6x5_manuform.dtsi"

&default_transform {
    col-offset = <6>;
};

&kscan0 {
    col-gpios
        = <&gpio0 28 GPIO_ACTIVE_HIGH> 
        , <&gpio1 06 GPIO_ACTIVE_HIGH> 
        , <&gpio1 13 GPIO_ACTIVE_HIGH> 
        , <&gpio0 10 GPIO_ACTIVE_HIGH> 
        , <&gpio1 02 GPIO_ACTIVE_HIGH> 
        , <&gpio0 09 GPIO_ACTIVE_HIGH>
        ;
};
