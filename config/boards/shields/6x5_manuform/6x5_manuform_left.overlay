// 6x5_manuform_left.overlay

#include "6x5_manuform.dtsi" 

&kscan0 {
    col-gpios
        = <&gpio0 28 GPIO_ACTIVE_HIGH> 
        , <&gpio1 6 GPIO_ACTIVE_HIGH> 
        , <&gpio1 13 GPIO_ACTIVE_HIGH> 
        , <&gpio0 10 GPIO_ACTIVE_HIGH> 
        , <&gpio1 2 GPIO_ACTIVE_HIGH> 
        , <&gpio0 9 GPIO_ACTIVE_HIGH>
        ;
};
